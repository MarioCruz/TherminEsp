## main/Kconfig.projbuild
```kconfig
menu "TherminEsp"

    config THEREMIN_TRACE_FRAMES
        bool "Log per-frame detection trace (score, latency, position)"
        default n
        help
            Prints a throttled per-frame line from the hand tracker for
            diagnosing detection dropouts and latency.

    config THEREMIN_BOOT_SCREENSHOT
        bool "Dump a screenshot over serial ~8 s after boot"
        default n
        help
            One-shot remote screenshot for documentation: renders the LVGL
            screen and prints it as base64 RGB565 between SCREENSHOT
            BEGIN/END markers (~90 s at 115200 baud).

    config THEREMIN_DUMP_FIRST_FRAME
        bool "Dump the first detector-input frame over serial"
        default n
        help
            One-shot image-quality check: prints the first 224x224 RGB888
            frame the detector sees as base64 (FRAMEDUMP BEGIN/END markers)
            so it can be inspected off-board. This is what diagnosed the
            camera orientation and JPEG byte-order bugs during initial
            bring-up — enable when detection silently finds nothing and you
            need to see exactly what the model is looking at.

endmenu
```
